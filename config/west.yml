## hardware/cheapino/Kconfig
```kconfig
if SHIELD_CHEAPINOV2

config ZMK_BEHAVIOR_CHEAPINO_ENCODER
    bool
    default y

config ZMK_KSCAN_CHEAPINO_GHOST_FILTER
    bool
    default y

endif
```

## hardware/cheapino/dts/bindings/behaviors/zmk,behavior-cheapino-encoder.yaml
```yaml
description: Cheapino matrix-connected encoder behavior

compatible: "zmk,behavior-cheapino-encoder"

include: one_param.yaml

properties:
  bindings:
    type: phandle-array
    required: true
  mac-nav-layer:
    type: int
    required: true
  mac-num-layer:
    type: int
    required: true
  system-layer:
    type: int
    required: true
```

## hardware/cheapino/dts/bindings/kscan/zmk,kscan-cheapino-ghost-filter.yaml
```yaml
description: Cheapino v2 phantom-key filtering Kscan wrapper

compatible: "zmk,kscan-cheapino-ghost-filter"

include: kscan.yaml

properties:
  kscan:
    type: phandle
    required: true
    description: Underlying 14-pin charlieplex Kscan device
```
